## config/west.yml
```yaml
manifest:
  remotes:
    - name: zmkfirmware
      url-base: https://github.com/zmkfirmware
    - name: lesshonor
      url-base: https://github.com/lesshonor
  projects:
    - name: zmk
      remote: lesshonor
      revision: studio/keymap-subsystem/many-layouts
      import: app/west.yml
```
